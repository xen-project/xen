## linux-2.6.7-xen-sparse/arch/xen/Kconfig
```kconfig
#
# For a description of the syntax of this configuration file,
# see Documentation/kbuild/kconfig-language.txt.
#

mainmenu "Linux Kernel Configuration"

config XEN
	bool
	default y
	help
	  This is the Linux Xen port.

config ARCH_XEN
	bool
	default y


config NO_IDLE_HZ
	bool
	default y


menu "XEN"

config XEN_PRIVILEGED_GUEST
	bool "Privileged Guest (domain 0)"
	default n
	help
	  Support for privileged operation (domain 0)

config XEN_PHYSDEV_ACCESS
	bool "Device-driver domain (physical device access)"
	default y if XEN_PRIVILEGED_GUEST
	default n
	help
	  Device-driver domain (physical device access)

endmenu


#config VT
#	bool
#	default y

#config VT_CONSOLE
#	bool
#	default y

#config HW_CONSOLE
#	bool
#	default y

choice
	prompt "Processor Type"
	default X86

config X86
	bool "X86"
	help
	  Choose this option if your computer is a X86 architecture.

config X86_64
	bool "X86_64"
	help
	  Choose this option if your computer is a X86 architecture.

endchoice

source "init/Kconfig"

if X86
source "arch/xen/i386/Kconfig"
endif

menu "Executable file formats"

source "fs/Kconfig.binfmt"

endmenu

source "arch/xen/Kconfig.drivers"

source "fs/Kconfig"

source "security/Kconfig"

source "crypto/Kconfig"

source "lib/Kconfig"
```

## linux-2.6.8.1-xen-sparse/arch/xen/Kconfig.drivers
```kconfig
# arch/xen/Kconfig.drivers

menu "Device Drivers"

source "drivers/base/Kconfig"

source "drivers/scsi/Kconfig"
source "drivers/block/Kconfig"
source "drivers/md/Kconfig"

# Always include scsi and block to enable iscsi, loop0 etc.

if XEN_PHYSDEV_ACCESS
source "drivers/ide/Kconfig"
source "drivers/cdrom/Kconfig"
endif

source "net/Kconfig"

if XEN_PRIVILEGED_GUEST
source "drivers/input/Kconfig"
endif

config INPUT
	tristate "Input devices (needed for keyboard, mouse, ...)" if EMBEDDED
	default y
	---help---
	  Say Y here if you have any input device (mouse, keyboard, tablet,
	  joystick, steering wheel ...) connected to your system and want
	  it to be available to applications. This includes standard PS/2
	  keyboard and mouse.

	  Say N here if you have a headless (no monitor, no keyboard) system.

	  More information is available: <file:Documentation/input/input.txt>

	  If unsure, say Y.

	  To compile this driver as a module, choose M here: the
	  module will be called input.

if XEN_PRIVILEGED_GUEST
source "drivers/char/Kconfig"
endif

config UNIX98_PTYS
	bool "Unix98 PTY support" if EMBEDDED
	default y
	---help---
	  A pseudo terminal (PTY) is a software device consisting of two
	  halves: a master and a slave. The slave device behaves identical to
	  a physical terminal; the master device is used by a process to
	  read data from and write data to the slave, thereby emulating a
	  terminal. Typical programs for the master side are telnet servers
	  and xterms.

	  Linux has traditionally used the BSD-like names /dev/ptyxx for
	  masters and /dev/ttyxx for slaves of pseudo terminals. This scheme
	  has a number of problems. The GNU C library glibc 2.1 and later,
	  however, supports the Unix98 naming standard: in order to acquire a
	  pseudo terminal, a process opens /dev/ptmx; the number of the pseudo
	  terminal is then made available to the process and the pseudo
	  terminal slave can be accessed as /dev/pts/<number>. What was
	  traditionally /dev/ttyp2 will then be /dev/pts/2, for example.

	  All modern Linux systems use the Unix98 ptys.  Say Y unless
	  you're on an embedded system and want to conserve memory.


if XEN_PHYSDEV_ACCESS
source "drivers/i2c/Kconfig"
source "drivers/video/Kconfig"
endif

#config XEN_EVTCHN
#	bool "Xen Event Channel"
#	depends on XEN
#	default Y
#
#config XEN_CONSOLE
#	bool "Xen Console"
#	depends on XEN && XEN_EVTCHN
#	default Y
#	help
#	  Say Y to build a console driver for Xen.

endmenu
```

## xen/Kconfig
```kconfig
#
# For a description of the syntax of this configuration file,
# see docs/misc/kconfig-language.txt
#
mainmenu "Xen/$(SRCARCH) $(XEN_FULLVERSION) Configuration"

source "scripts/Kconfig.include"

config BROKEN
	bool

config CC_IS_GCC
	def_bool $(success,$(CC) --version | head -n 1 | grep -q gcc)

config GCC_VERSION
	int
	default $(shell,$(srctree)/scripts/gcc-version.sh $(CC))

config CC_IS_CLANG
	def_bool $(success,$(CC) --version | head -n 1 | grep -q clang)

config CLANG_VERSION
	int
	default $(shell,$(srctree)/scripts/clang-version.sh $(CC))

config LD_IS_GNU
	def_bool $(success,$(LD) --version | head -n 1 | grep -q "^GNU ld")

config LD_IS_LLVM
	def_bool $(success,$(LD) --version | head -n 1 | grep -q "^LLD")

config CC_HAS_ASM_INLINE
	# GCC >= 9, Clang >= 11
	def_bool $(success,echo 'void foo(void) { asm inline (""); }' | $(CC) -x c - -c -o /dev/null)

# Use -f{function,data}-sections compiler parameters
config CC_SPLIT_SECTIONS
	bool

# Fixed in GCC 14, 13.3, 12.4 and 11.5
# https://gcc.gnu.org/bugzilla/show_bug.cgi?id=113921
config GCC_ASM_GOTO_OUTPUT_BROKEN
	bool
	depends on CC_IS_GCC
	default y if GCC_VERSION < 110500
	default y if GCC_VERSION >= 120000 && GCC_VERSION < 120400
	default y if GCC_VERSION >= 130000 && GCC_VERSION < 130300

config CC_HAS_ASM_GOTO_OUTPUT
	def_bool y
	depends on !GCC_ASM_GOTO_OUTPUT_BROKEN
	depends on $(success,echo 'int foo(int x) { asm goto ("": "=r"(x) ::: bar); return x; bar: return 0; }' | $(CC) -x c - -c -o /dev/null)

# Compiler supports -fcondition-coverage aka MC/DC
config CC_HAS_MCDC
	def_bool $(cc-option,-fcondition-coverage)

# Set code alignment.
#
# Allow setting on a boolean basis, and then convert such selection to an
# integer for the build system and code to consume more easily.
config FUNCTION_ALIGNMENT_4B
	bool
config FUNCTION_ALIGNMENT_8B
	bool
config FUNCTION_ALIGNMENT_16B
	bool
config FUNCTION_ALIGNMENT
	int
	default 16 if FUNCTION_ALIGNMENT_16B
	default  8 if  FUNCTION_ALIGNMENT_8B
	default  4 if  FUNCTION_ALIGNMENT_4B
	default  0

source "arch/$(SRCARCH)/Kconfig"

config DEFCONFIG_LIST
	string
	option defconfig_list
	default ARCH_DEFCONFIG

config EXPERT
	bool "Configure EXPERT features"
	help
	  This option allows certain base Xen options and settings
	  to be disabled or tweaked. This is for specialized environments
	  which can tolerate a "non-standard" Xen.
	  Only use this if you really know what you are doing.
	  Xen binaries built with this option enabled are not security
	  supported.
	default n

config UNSUPPORTED
	bool "Configure UNSUPPORTED features"
	default EXPERT
	help
	  This option allows certain unsupported Xen options to be changed,
	  which includes non-security-supported, experimental, and tech
	  preview features as defined by SUPPORT.md. (Note that if an option
	  doesn't depend on UNSUPPORTED it doesn't imply that is supported.)

config LTO
	bool "Link Time Optimisation"
	depends on BROKEN
	help
	  Enable Link Time Optimisation.

	  If unsure, say N.

#
# For architectures that know their compiler __int128 support is sound
#
config ARCH_SUPPORTS_INT128
	bool

#
# For platforms that require specific handling of per-vCPU ioreq completion
# events
#
config ARCH_VCPU_IOREQ_COMPLETION
	bool

source "Kconfig.debug"
```

## xen/Kconfig.debug
```kconfig
menu "Debugging Options"

config DEBUG
	bool "Developer Checks"
	default y
	---help---
	  If you say Y here this will enable developer checks such as asserts
	  and extra printks. This option is intended for development purposes
	  only, and not for production use.

	  You probably want to say 'N' here.

if DEBUG || EXPERT = "y"

config CRASH_DEBUG
	bool "Crash Debugging Support"
	depends on X86
	---help---
	  If you want to attach gdb to Xen to debug Xen if it crashes
	  then say Y.

config GDBSX
	bool "Guest debugging with gdbsx"
	depends on X86
	default y
	---help---
	  If you want to enable support for debugging guests from dom0 via
	  gdbsx then say Y.

config DEBUG_INFO
	bool "Compile Xen with debug info"
	default y
	---help---
	  If you say Y here the resulting Xen will include debugging info
	  resulting in a larger binary image.

config FRAME_POINTER
	bool "Compile Xen with frame pointers"
	default DEBUG
	---help---
	  If you say Y here the resulting Xen will be slightly larger and
	  maybe slower, but it gives very useful debugging information
	  in case of any Xen bugs.

config COVERAGE
	bool "Code coverage support"
	depends on !LIVEPATCH
	select SUPPRESS_DUPLICATE_SYMBOL_WARNINGS if !ENFORCE_UNIQUE_SYMBOLS
	---help---
	  Enable code coverage support.

	  If unsure, say N here.

config DEBUG_LOCK_PROFILE
	bool "Lock Profiling"
	select DEBUG_LOCKS
	---help---
	  Lock profiling allows you to see how often locks are taken and blocked.
	  You can use serial console to print (and reset) using 'l' and 'L'
	  respectively, or the 'xenlockprof' tool.

config DEBUG_LOCKS
	bool "Lock debugging"
	default DEBUG
	---help---
	  Enable debugging features of lock handling.  Some additional
	  checks will be performed when acquiring and releasing locks.

config PERF_COUNTERS
	bool "Performance Counters"
	---help---
	  Enables software performance counters that allows you to analyze
	  bottlenecks in the system.  To access this data you can use serial
	  console to print (and reset) using 'p' and 'P' respectively, or
	  the 'xenperf' tool.

config PERF_ARRAYS
	bool "Performance Counter Array Histograms"
	depends on PERF_COUNTERS
	---help---
	  Enables software performance counter array histograms.


config VERBOSE_DEBUG
	bool "Verbose debug messages"
	default DEBUG
	---help---
	  Guest output from HYPERVISOR_console_io and hypervisor parsing
	  ELF images (dom0) will be logged in the Xen ring buffer.

config DEVICE_TREE_DEBUG
	bool "Device tree debug messages"
	depends on HAS_DEVICE_TREE
	---help---
	  Device tree parsing and DOM0 device tree building messages are
	  logged in the Xen ring buffer.
	  If unsure, say N here.

config SCRUB_DEBUG
	bool "Page scrubbing test"
	default DEBUG
	---help---
	  Verify that pages that need to be scrubbed before being allocated to
	  a guest are indeed scrubbed.

config UBSAN
	bool "Undefined behaviour sanitizer"
	depends on HAS_UBSAN
	---help---
	  Enable undefined behaviour sanitizer. It uses compiler to insert code
	  snippets so that undefined behaviours in C are detected during runtime.
	  This requires a UBSAN capable compiler and it is a debug only feature.

	  If unsure, say N here.

config DEBUG_TRACE
	bool "Debug trace support"
	---help---
	  Debug trace enables to record debug trace messages which are printed
	  either directly to the console or are printed to console in case of
	  a system crash.

config XMEM_POOL_POISON
	bool "Poison free xenpool blocks"
	default DEBUG
	---help---
	  Poison free blocks with 0xAA bytes and verify them when a block is
	  allocated in order to spot use-after-free issues.

endif # DEBUG || EXPERT

endmenu
```

## xen/arch/Kconfig
```kconfig
config 64BIT
	bool

config PHYS_ADDR_T_32
	bool

config NR_CPUS
	int "Maximum number of CPUs"
	range 1 1 if ARM && MPU
	range 1 16383
	default "256" if X86
	default "1" if ARM && MPU
	default "8" if ARM && RCAR3
	default "4" if ARM && QEMU
	default "4" if ARM && MPSOC
	default "128" if ARM
	help
	  Controls the build-time size of various arrays and bitmaps
	  associated with multiple-cpu management.  It is the upper bound of
	  the number of logical entities the scheduler can run code on.

	  For CPU cores which support Simultaneous Multi-Threading or similar
	  technologies, this the number of logical threads which Xen will
	  support.

config NR_NUMA_NODES
	int "Maximum number of NUMA nodes supported"
	range 2 64
	default "64"
	depends on NUMA
	help
	  Controls the build-time size of various arrays and bitmaps
	  associated with multiple-nodes management. It is the upper bound of
	  the number of NUMA nodes that the scheduler, memory allocation and
	  other NUMA-aware components can handle.
```
