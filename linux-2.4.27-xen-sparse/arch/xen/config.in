## xen/arch/arm/Kconfig.debug
```kconfig
choice
	bool "Early printk"
	optional
	help
		You may want to enable early printk if you are debugging code
		that executes before the console is initialized.

		Note that selecting this option will limit Xen to a single UART
		definition. Attempting to boot Xen image on a different
		platform *will not work*, so this option should not be enable
		for Xens that are intended to be portable.

		Choose one of the UART drivers for early printk, then you'll
		have to specify the parameters, like the base address.

	config EARLY_UART_CHOICE_8250
		select EARLY_UART_8250
		bool "Early printk via 8250 UART"
		help
			Say Y here if you wish the early printk to direct their
			output to a 8250 UART.

	config EARLY_UART_CHOICE_CADENCE
		select EARLY_UART_CADENCE
		depends on ARM_64
		bool "Early printk via Cadence UART"
		help
			Say Y here if you wish the early printk to direct their
			output to a Cadence UART.

	config EARLY_UART_CHOICE_EXYNOS4210
		select EARLY_UART_EXYNOS4210
		depends on ARM_32
		bool "Early printk via Exynos4210 UART"
		help
			Say Y here if you wish the early printk to direct their
			output to a Exynos 4210 UART.

	config EARLY_UART_CHOICE_IMX_LPUART
		select EARLY_UART_IMX_LPUART
		depends on ARM_64
		bool "Early printk via i.MX LPUART"
		help
			Say Y here if you wish the early printk to direct their
			output to a i.MX LPUART.

	config EARLY_UART_CHOICE_LINFLEX
		select EARLY_UART_LINFLEX
		depends on ARM_64
		bool "Early printk via NXP LINFlexD UART"
		help
			Say Y here if you wish the early printk to direct their
			output to an NXP LINFlexD UART.

	config EARLY_UART_CHOICE_MESON
		select EARLY_UART_MESON
		depends on ARM_64
		bool "Early printk via MESON UART"
		help
			Say Y here if you wish the early printk to direct their
			output to a MESON UART.

	config EARLY_UART_CHOICE_MVEBU
		select EARLY_UART_MVEBU
		depends on ARM_64
		bool "Early printk via MVEBU UART"
		help
			Say Y here if you wish the early printk to direct their
			output to a MVEBU UART.

	config EARLY_UART_CHOICE_PL011
		select EARLY_UART_PL011
		bool "Early printk via PL011 UART"
		help
			Say Y here if you wish the early printk to direct their
			output to a PL011 UART.

	config EARLY_UART_CHOICE_SCIF
		select EARLY_UART_SCIF
		bool "Early printk via SCIF UART"
		help
			Say Y here if you wish the early printk to direct their
			output to a SCIF UART.

endchoice


config EARLY_UART_8250
	select EARLY_PRINTK
	bool
config EARLY_UART_CADENCE
	select EARLY_PRINTK
	bool
config EARLY_UART_EXYNOS4210
	select EARLY_PRINTK
	bool
config EARLY_UART_IMX_LPUART
	select EARLY_PRINTK
	bool
config EARLY_UART_LINFLEX
	select EARLY_PRINTK
	bool
config EARLY_UART_MESON
	select EARLY_PRINTK
	bool
config EARLY_UART_MVEBU
	select EARLY_PRINTK
	bool
config EARLY_UART_PL011
	select EARLY_PRINTK
	bool
config EARLY_UART_SCIF
	select EARLY_PRINTK
	bool

config EARLY_PRINTK
	bool

config EARLY_UART_BASE_ADDRESS
	depends on EARLY_PRINTK
	hex "Early printk, physical base address of debug UART"
	range 0x0 0xffffffff if ARM_32

config EARLY_UART_SIZE
       depends on EARLY_PRINTK
       depends on MPU
       hex "Early printk, physical size of debug UART"
       range 0x0 0xffffffff if ARM_32
       default 0x1000

config EARLY_UART_PL011_BAUD_RATE
	depends on EARLY_UART_PL011
	int "Early printk UART baud rate for pl011"
	help
		Optionally sets the baud rate which should be used to configure
		the UART at start of day.

		If EARLY_UART_PL011_BAUD_RATE is set to 0 then the code will
		not try to initialize the UART, so that bootloader or firmware
		settings can be used for maximum compatibility.

	default 0

config EARLY_UART_PL011_MMIO32
	bool "32-bit only MMIO for PL011 early printk"
	depends on EARLY_UART_PL011
	help
	  If specified, all accesses to PL011 registers made from early printk code
	  will be done using 32-bit only accessors.

config EARLY_UART_INIT
	depends on EARLY_UART_PL011 && EARLY_UART_PL011_BAUD_RATE != 0
	def_bool y

config EARLY_UART_8250_REG_SHIFT
	depends on EARLY_UART_8250
	int "Early printk, left-shift to apply to the register offsets within the 8250 UART"
	help
		EARLY_UART_8250_REG_SHIFT is, optionally, the left-shift to
		apply to the register offsets within the UART with early
		printk.

		Default to 0.

	default 0

choice EARLY_UART_SCIF_VERSION
	prompt "Early printk UART SCIF interface version"
	depends on EARLY_UART_SCIF
	default EARLY_UART_SCIF_VERSION_NONE
	help
		Select the interface version of the SCIF UART.

		Select EARLY_UART_SCIF_VERSION_NONE to use the default
		interface version (SCIF).
	config EARLY_UART_SCIF_VERSION_NONE
		bool "default SCIF UART interface"
	config EARLY_UART_SCIF_VERSION_A
		bool "SCIF UART interface version A"
endchoice

config EARLY_PRINTK_INC
	string
	default "debug-8250.inc" if EARLY_UART_8250
	default "debug-cadence.inc" if EARLY_UART_CADENCE
	default "debug-exynos4210.inc" if EARLY_UART_EXYNOS4210
	default "debug-imx-lpuart.inc" if EARLY_UART_IMX_LPUART
	default "debug-linflex.inc" if EARLY_UART_LINFLEX
	default "debug-meson.inc" if EARLY_UART_MESON
	default "debug-mvebu.inc" if EARLY_UART_MVEBU
	default "debug-pl011.inc" if EARLY_UART_PL011
	default "debug-scif.inc" if EARLY_UART_SCIF
```

## xen/arch/arm/firmware/Kconfig
```kconfig
config ARM_SCI
	bool
	depends on ARM
	help
	  This option enables generic Arm SCI (System Control Interface) mediators
	  support. It allows domains to control system resources via one of
	  Arm SCI mediators drivers implemented in XEN, like SCMI.

menu "Firmware Drivers"

choice
	prompt "ARM SCI driver type"
	default SCMI_SMC
	help
	Choose which ARM SCI driver to enable.

config ARM_SCI_NONE
	bool "none"

config SCMI_SMC
	bool "Forward SCMI over SMC calls from hwdom to EL3 firmware"
	select ARM_SCI
	help
	  This option enables basic awareness for SCMI calls using SMC as
	  doorbell mechanism and Shared Memory for transport ("arm,scmi-smc"
	  compatible only). The value of "arm,smc-id" DT property from SCMI
	  firmware node is used to trap and forward corresponding SCMI SMCs
	  to firmware running at EL3, for calls coming from the hardware domain.

endchoice

endmenu
```

## xen/arch/arm/platforms/Kconfig
```kconfig
choice
	prompt "Platform Support"
	default ALL_PLAT
	---help---
	Choose which hardware platform to enable in Xen.

	If unsure, choose ALL_PLAT.

config ALL_PLAT
	bool "All Platforms"
	---help---
	Enable support for all available hardware platforms. It doesn't
	automatically select any of the related drivers.

config QEMU
	bool "QEMU aarch virt machine support"
	depends on ARM_64
	select GICV3
	select HAS_PL011
	---help---
	Enable all the required drivers for QEMU aarch64 virt emulated
	machine.

config RCAR3
	bool "Renesas RCar3 support"
	depends on ARM_64
	select HAS_SCIF
	select IPMMU_VMSA
	---help---
	Enable all the required drivers for Renesas RCar3

config MPSOC
	bool "Xilinx Ultrascale+ MPSoC support"
	depends on ARM_64
	select HAS_CADENCE_UART
	select ARM_SMMU
	---help---
	Enable all the required drivers for Xilinx Ultrascale+ MPSoC

config NO_PLAT
	bool "No Platforms"
	---help---
	Do not enable specific support for any platform.

endchoice

config ALL64_PLAT
	bool
	default (ALL_PLAT && ARM_64)

config ALL32_PLAT
	bool
	default (ALL_PLAT && ARM_32)

config MPSOC_PLATFORM
	bool
	default (ALL64_PLAT || MPSOC)
```

## xen/arch/arm/tee/Kconfig
```kconfig
menu "TEE mediators"
	visible if UNSUPPORTED

config TEE
	bool
	default n

config OPTEE
	bool "Enable OP-TEE mediator (UNSUPPORTED)" if UNSUPPORTED
	default n
	select TEE
	help
	  Enable the OP-TEE mediator. It allows guests to access
	  OP-TEE running on your platform. This requires
	  virtualization-enabled OP-TEE present. You can learn more
	  about virtualization for OP-TEE at
	  https://optee.readthedocs.io/architecture/virtualization.html

config FFA
	bool "Enable FF-A mediator support (UNSUPPORTED)" if UNSUPPORTED
	default n
	depends on ARM_64
	select TEE
	help
	  This option enables a minimal FF-A mediator. The mediator is
	  generic as it follows the FF-A specification [1], but it only
	  implements a small subset of the specification.

	  [1] https://developer.arm.com/documentation/den0077/latest

config FFA_VM_TO_VM
    bool "Enable FF-A between VMs (UNSUPPORTED)" if UNSUPPORTED
    default n
    depends on FFA
    help
      This option enables to use FF-A between VMs.
      This is experimental and there is no access control so any
      guest can communicate with any other guest.

      If unsure, say N.

endmenu
```

## xen/arch/ppc/Kconfig
```kconfig
config PPC
	def_bool y
	select FUNCTION_ALIGNMENT_4B
	select HAS_DEVICE_TREE
	select HAS_UBSAN
	select HAS_VMAP

config PPC64
	def_bool y
	select 64BIT

config ARCH_DEFCONFIG
	string
	default "arch/ppc/configs/ppc64_defconfig"

menu "Architecture Features"

source "arch/Kconfig"

endmenu

menu "ISA Selection"

choice
	prompt "Base ISA"
	default POWER_ISA_3_00
	help
	  This selects the base ISA version that Xen will target.

config POWER_ISA_3_00
	bool "Power ISA 3.00 (POWER9)"
	help
	  Target version 3.00 of the Power ISA (POWER9) or later

endchoice

endmenu

source "common/Kconfig"

source "drivers/Kconfig"
```
