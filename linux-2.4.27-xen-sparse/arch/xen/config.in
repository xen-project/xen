## linux-2.4.27-xen-sparse/arch/xen/config.in
```kconfig
#
# For a description of the syntax of this configuration file,
# see Documentation/kbuild/config-language.txt.
#
mainmenu_name "Linux Kernel Configuration"

define_bool CONFIG_XEN y

define_bool CONFIG_X86 y
define_bool CONFIG_ISA y
define_bool CONFIG_SBUS n

define_bool CONFIG_UID16 y

mainmenu_option next_comment
comment 'Xen'
bool 'Support for privileged operations (domain 0)' CONFIG_XEN_PRIVILEGED_GUEST
bool 'Device-driver domain (physical device access)' CONFIG_XEN_PHYSDEV_ACCESS
bool 'Scrub memory before freeing it to Xen' CONFIG_XEN_SCRUB_PAGES
bool 'Network-device frontend driver' CONFIG_XEN_NETDEV_FRONTEND
bool 'Block-device frontend driver' CONFIG_XEN_BLKDEV_FRONTEND
endmenu
# The IBM S/390 patch needs this.
define_bool CONFIG_NO_IDLE_HZ y

if [ "$CONFIG_XEN_PHYSDEV_ACCESS" == "y" ]; then
   define_bool CONFIG_FOREIGN_PAGES y
else
   define_bool CONFIG_FOREIGN_PAGES n
   define_bool CONFIG_NETDEVICES y
   define_bool CONFIG_VT n
fi

mainmenu_option next_comment
comment 'Code maturity level options'
bool 'Prompt for development and/or incomplete code/drivers' CONFIG_EXPERIMENTAL
endmenu

mainmenu_option next_comment
comment 'Loadable module support'
bool 'Enable loadable module support' CONFIG_MODULES
if [ "$CONFIG_MODULES" = "y" ]; then
   bool '  Set version information on all module symbols' CONFIG_MODVERSIONS
   bool '  Kernel module loader' CONFIG_KMOD
fi
endmenu

mainmenu_option next_comment
comment 'Processor type and features'
choice 'Processor family' \
	"Pentium-Pro/Celeron/Pentium-II		CONFIG_M686 \
	 Pentium-III/Celeron(Coppermine)	CONFIG_MPENTIUMIII \
	 Pentium-4				CONFIG_MPENTIUM4 \
	 Athlon/Duron/K7			CONFIG_MK7 \
	 Opteron/Athlon64/Hammer/K8             CONFIG_MK8 \
	 VIA-C3-2                               CONFIG_MVIAC3_2" Pentium-Pro

   define_bool CONFIG_X86_WP_WORKS_OK y
   define_bool CONFIG_X86_INVLPG y
   define_bool CONFIG_X86_CMPXCHG y
   define_bool CONFIG_X86_XADD y
   define_bool CONFIG_X86_BSWAP y
   define_bool CONFIG_X86_POPAD_OK y
   define_bool CONFIG_RWSEM_GENERIC_SPINLOCK n
   define_bool CONFIG_RWSEM_XCHGADD_ALGORITHM y

   define_bool CONFIG_X86_GOOD_APIC y
   define_bool CONFIG_X86_PGE y
   define_bool CONFIG_X86_USE_PPRO_CHECKSUM y
   define_bool CONFIG_X86_TSC y

if [ "$CONFIG_M686" = "y" ]; then
   define_int  CONFIG_X86_L1_CACHE_SHIFT 5
fi
if [ "$CONFIG_MPENTIUMIII" = "y" ]; then
   define_int  CONFIG_X86_L1_CACHE_SHIFT 5
fi
if [ "$CONFIG_MPENTIUM4" = "y" ]; then
   define_int  CONFIG_X86_L1_CACHE_SHIFT 7
fi
if [ "$CONFIG_MK8" = "y" ]; then
   define_bool CONFIG_MK7 y
fi
if [ "$CONFIG_MK7" = "y" ]; then
   define_int  CONFIG_X86_L1_CACHE_SHIFT 6
   define_bool CONFIG_X86_USE_3DNOW y
fi
if [ "$CONFIG_MVIAC3_2" = "y" ]; then
   define_int  CONFIG_X86_L1_CACHE_SHIFT 5
fi

#if [ "$CONFIG_EXPERIMENTAL" = "y" ]; then
#   tristate 'BIOS Enhanced Disk Drive calls determine boot disk (EXPERIMENTAL)' CONFIG_EDD
#fi

choice 'High Memory Support' \
	"off    CONFIG_NOHIGHMEM \
	 4GB    CONFIG_HIGHMEM4G" off
#	 64GB   CONFIG_HIGHMEM64G" off
if [ "$CONFIG_HIGHMEM4G" = "y" ]; then
   define_bool CONFIG_HIGHMEM y
fi
if [ "$CONFIG_HIGHMEM64G" = "y" ]; then
   define_bool CONFIG_HIGHMEM y
   define_bool CONFIG_X86_PAE y
fi

if [ "$CONFIG_HIGHMEM" = "y" ]; then
   bool 'HIGHMEM I/O support' CONFIG_HIGHIO
fi

define_int CONFIG_FORCE_MAX_ZONEORDER 11

#bool 'Symmetric multi-processing support' CONFIG_SMP
#if [ "$CONFIG_SMP" = "y" -a "$CONFIG_X86_CMPXCHG" = "y" ]; then
#   define_bool CONFIG_HAVE_DEC_LOCK y
#fi
endmenu

mainmenu_option next_comment
comment 'General setup'

bool 'Networking support' CONFIG_NET

if [ "$CONFIG_XEN_PHYSDEV_ACCESS" = "y" ]; then
   bool 'PCI support' CONFIG_PCI
   source drivers/pci/Config.in

   bool 'Support for hot-pluggable devices' CONFIG_HOTPLUG

   if [ "$CONFIG_HOTPLUG" = "y" ] ; then
      source drivers/pcmcia/Config.in
      source drivers/hotplug/Config.in
   else
      define_bool CONFIG_PCMCIA n
      define_bool CONFIG_HOTPLUG_PCI n
   fi
fi

bool 'System V IPC' CONFIG_SYSVIPC
bool 'BSD Process Accounting' CONFIG_BSD_PROCESS_ACCT
bool 'Sysctl support' CONFIG_SYSCTL
if [ "$CONFIG_PROC_FS" = "y" ]; then
   choice 'Kernel core (/proc/kcore) format' \
	"ELF		CONFIG_KCORE_ELF	\
	 A.OUT		CONFIG_KCORE_AOUT" ELF
fi
tristate 'Kernel support for a.out binaries' CONFIG_BINFMT_AOUT
tristate 'Kernel support for ELF binaries' CONFIG_BINFMT_ELF
tristate 'Kernel support for MISC binaries' CONFIG_BINFMT_MISC
bool 'Select task to kill on out of memory condition' CONFIG_OOM_KILLER

endmenu

if [ "$CONFIG_XEN_PHYSDEV_ACCESS" = "y" ]; then
   source drivers/mtd/Config.in

   source drivers/parport/Config.in

   source drivers/pnp/Config.in

   source drivers/block/Config.in

   source drivers/md/Config.in
fi

if [ "$CONFIG_NET" = "y" ]; then
   source net/Config.in
fi

if [ "$CONFIG_XEN_PHYSDEV_ACCESS" = "y" ]; then
   mainmenu_option next_comment
   comment 'ATA/IDE/MFM/RLL support'

   tristate 'ATA/IDE/MFM/RLL support' CONFIG_IDE

   if [ "$CONFIG_IDE" != "n" ]; then
      source drivers/ide/Config.in
   else
      define_bool CONFIG_BLK_DEV_HD n
   fi
   endmenu
fi

mainmenu_option next_comment
comment 'SCSI support'

tristate 'SCSI support' CONFIG_SCSI

if [ "$CONFIG_SCSI" != "n" ]; then
   source drivers/scsi/Config.in
fi
endmenu

if [ "$CONFIG_XEN_PHYSDEV_ACCESS" = "y" ]; then
   source drivers/message/fusion/Config.in

   source drivers/ieee1394/Config.in

   source drivers/message/i2o/Config.in

   if [ "$CONFIG_NET" = "y" ]; then
      mainmenu_option next_comment
      comment 'Network device support'

      bool 'Network device support' CONFIG_NETDEVICES
      if [ "$CONFIG_NETDEVICES" = "y" ]; then
         source drivers/net/Config.in
         if [ "$CONFIG_ATM" = "y" -o "$CONFIG_ATM" = "m" ]; then
            source drivers/atm/Config.in
         fi
      fi
      endmenu
   fi

   source net/ax25/Config.in

   source net/irda/Config.in

   mainmenu_option next_comment
   comment 'ISDN subsystem'
   if [ "$CONFIG_NET" != "n" ]; then
      tristate 'ISDN support' CONFIG_ISDN
      if [ "$CONFIG_ISDN" != "n" ]; then
         source drivers/isdn/Config.in
      fi
   fi
   endmenu

   if [ "$CONFIG_ISA" = "y" ]; then
       mainmenu_option next_comment
       comment 'Old CD-ROM drivers (not SCSI, not IDE)'
   
       bool 'Support non-SCSI/IDE/ATAPI CDROM drives' CONFIG_CD_NO_IDESCSI
       if [ "$CONFIG_CD_NO_IDESCSI" != "n" ]; then
          source drivers/cdrom/Config.in
       fi
       endmenu
   fi

   #
   # input before char - char/joystick depends on it. As does USB.
   #
   source drivers/input/Config.in
else
   #
   # Block device driver configuration
   #
   mainmenu_option next_comment
   comment 'Block devices'
   tristate 'Loopback device support' CONFIG_BLK_DEV_LOOP
   dep_tristate 'Network block device support' CONFIG_BLK_DEV_NBD $CONFIG_NET
   tristate 'RAM disk support' CONFIG_BLK_DEV_RAM
   if [ "$CONFIG_BLK_DEV_RAM" = "y" -o "$CONFIG_BLK_DEV_RAM" = "m" ]; then
      int '  Default RAM disk size' CONFIG_BLK_DEV_RAM_SIZE 4096
   fi
   dep_bool '  Initial RAM disk (initrd) support' CONFIG_BLK_DEV_INITRD $CONFIG_BLK_DEV_RAM
   bool 'Per partition statistics in /proc/partitions' CONFIG_BLK_STATS
   define_bool CONFIG_BLK_DEV_HD n
   endmenu
fi

source drivers/char/Config.in

if [ "$CONFIG_XEN_PHYSDEV_ACCESS" = "y" ]; then
   source drivers/media/Config.in
fi

source fs/Config.in

mainmenu_option next_comment
comment 'Console drivers'

define_bool CONFIG_XEN_CONSOLE y

if [ "$CONFIG_VT" = "y" ]; then
   bool 'VGA text console' CONFIG_VGA_CONSOLE
   bool 'Dummy console' CONFIG_DUMMY_CONSOLE 
   if [ "$CONFIG_XEN_PHYSDEV_ACCESS" = "y" ]; then
      bool 'Video mode selection support' CONFIG_VIDEO_SELECT
      if [ "$CONFIG_EXPERIMENTAL" = "y" ]; then
         tristate 'MDA text console (dual-headed) (EXPERIMENTAL)' CONFIG_MDA_CONSOLE
         source drivers/video/Config.in
      fi
   fi
fi
endmenu

if [ "$CONFIG_XEN_PHYSDEV_ACCESS" = "y" ]; then
   mainmenu_option next_comment
   comment 'Sound'

   tristate 'Sound card support' CONFIG_SOUND
   if [ "$CONFIG_SOUND" != "n" ]; then
      source drivers/sound/Config.in
   fi
   endmenu

   source drivers/usb/Config.in

   source net/bluetooth/Config.in
fi

mainmenu_option next_comment
comment 'Kernel hacking'

bool 'Kernel debugging' CONFIG_DEBUG_KERNEL
if [ "$CONFIG_DEBUG_KERNEL" != "n" ]; then
   bool '  Check for stack overflows' CONFIG_DEBUG_STACKOVERFLOW
   bool '  Debug high memory support' CONFIG_DEBUG_HIGHMEM
   bool '  Debug memory allocations' CONFIG_DEBUG_SLAB
   bool '  Memory mapped I/O debugging' CONFIG_DEBUG_IOVIRT
   bool '  Magic SysRq key' CONFIG_MAGIC_SYSRQ
   bool '  Spinlock debugging' CONFIG_DEBUG_SPINLOCK
   bool '  Verbose BUG() reporting (adds 70K)' CONFIG_DEBUG_BUGVERBOSE
   bool '  Load all symbols for debugging' CONFIG_KALLSYMS
   bool '  Compile the kernel with frame pointers' CONFIG_FRAME_POINTER
fi

int 'Kernel messages buffer length shift (0 = default)' CONFIG_LOG_BUF_SHIFT 0

endmenu

source crypto/Config.in
source lib/Config.in
```

## linux-2.6-xen-sparse/arch/xen/Kconfig
```kconfig
#
# For a description of the syntax of this configuration file,
# see Documentation/kbuild/kconfig-language.txt.
#

mainmenu "Linux Kernel Configuration"

config XEN
	bool
	default y
	help
	  This is the Linux Xen port.

config ARCH_XEN
	bool
	default y


config NO_IDLE_HZ
	bool
	default y


menu "XEN"

config XEN_PRIVILEGED_GUEST
	bool "Privileged Guest (domain 0)"
	default n
	select XEN_PHYSDEV_ACCESS
	help
	  Support for privileged operation (domain 0)

config XEN_PHYSDEV_ACCESS
	bool "Physical device access"
	default XEN_PRIVILEGED_GUEST
	help
	  Assume access is available to physical hardware devices
	  (e.g., hard drives, network cards). This allows you to configure
	  such devices and also includes some low-level support that is
	  otherwise not compiled into the kernel.

config XEN_BLKDEV_BACKEND
	bool "Block-device backend driver"
	depends on XEN_PHYSDEV_ACCESS
	default y
	help
	  The block-device backend driver allows the kernel to export its
	  block devices to other guests via a high-performance shared-memory
	  interface.

config XEN_BLKDEV_TAP_BE
        bool "Block Tap support for backend driver (DANGEROUS)"
        depends on XEN_BLKDEV_BACKEND
        default n
        help
          If you intend to use the block tap driver, the backend domain will
          not know the domain id of the real frontend, and so will not be able
          to map its data pages.  This modifies the backend to attempt to map
          from both the tap domain and the real frontend.  This presents a
          security risk, and so should ONLY be used for development
          with the blktap.  This option will be removed as the block drivers are
          modified to use grant tables.

config XEN_NETDEV_BACKEND
	bool "Network-device backend driver"
	depends on XEN_PHYSDEV_ACCESS
	default y
	help
	  The network-device backend driver allows the kernel to export its
	  network devices to other guests via a high-performance shared-memory
	  interface.

config XEN_TPMDEV_FRONTEND
        bool "TPM-device frontend driver"
        default n
        help
          The TPM-device frontend driver.

config XEN_TPMDEV_BACKEND
        bool "TPM-device backend driver"
        default n
        help
          The TPM-device backend driver

config XEN_TPMDEV_CLOSE_IF_VTPM_FAILS
        bool "TPM backend closes upon vTPM failure"
        depends on XEN_TPMDEV_BACKEND
        default n
        help
          The TPM backend closes the channel if the vTPM in userspace indicates
          a failure. The corresponding domain's channel will be closed.
          Say Y if you want this feature.

config XEN_BLKDEV_FRONTEND
	bool "Block-device frontend driver"
	default y
	help
	  The block-device frontend driver allows the kernel to access block
	  devices mounted within another guest OS. Unless you are building a
	  dedicated device-driver domain, or your master control domain
	  (domain 0), then you almost certainly want to say Y here.

config XEN_NETDEV_FRONTEND
	bool "Network-device frontend driver"
	default y
	help
	  The network-device frontend driver allows the kernel to access
	  network interfaces within another guest OS. Unless you are building a
	  dedicated device-driver domain, or your master control domain
	  (domain 0), then you almost certainly want to say Y here.

config XEN_NETDEV_GRANT
        bool "Grant table substrate for network drivers (DANGEROUS)"
        default n
        help
          This introduces the use of grant tables as a data exhange mechanism
          between the frontend and backend network drivers.

config XEN_NETDEV_FRONTEND_PIPELINED_TRANSMITTER
	bool "Pipelined transmitter (DANGEROUS)"
	depends on XEN_NETDEV_FRONTEND
	default n
	help
	  The driver will assume that the backend is pipelining packets for
	  transmission: whenever packets are pending in the remote backend,
	  the driver will not send asynchronous notifications when it queues
	  additional packets for transmission.
	  If the backend is a dumb domain, such as a transparent Ethernet
	  bridge with no local IP interface, it is safe to say Y here to get
	  slightly lower network overhead.
	  If the backend has a local IP interface; or may be doing smart things
	  like reassembling packets to perform firewall filtering; or if you
	  are unsure; or if you experience network hangs when this option is
	  enabled; then you must say N here.

config XEN_BLKDEV_TAP
	bool "Block device tap driver"
	default n
	help
	  This driver allows a VM to interact on block device channels
	  to other VMs.  Block messages may be passed through or redirected
	  to a character device, allowing device prototyping in application
	  space.  Odds are that you want to say N here.

config XEN_SHADOW_MODE
	bool "Fake shadow mode"
	default n
    help
      fakes out a shadow mode kernel


config XEN_SCRUB_PAGES
	bool "Scrub memory before freeing it to Xen"
	default y
	help
	  Erase memory contents before freeing it back to Xen's global
	  pool. This ensures that any secrets contained within that
	  memory (e.g., private keys) cannot be found by other guests that
	  may be running on the machine. Most people will want to say Y here.
	  If security is not a concern then you may increase performance by
	  saying N.

choice
	prompt "Processor Type"
	default XEN_X86

config XEN_X86
	bool "X86"
	help
	  Choose this option if your computer is a X86 architecture.

config XEN_X86_64
	bool "X86_64"
	help
	  Choose this option if your computer is a X86_64 architecture.

endchoice

endmenu

config HAVE_ARCH_DEV_ALLOC_SKB
	bool
	default y

source "init/Kconfig"

if XEN_X86
source "arch/xen/i386/Kconfig"
endif

if XEN_X86_64
source "arch/xen/x86_64/Kconfig"
endif

menu "Executable file formats"

source "fs/Kconfig.binfmt"

endmenu

source "arch/xen/Kconfig.drivers"

if XEN_PRIVILEGED_GUEST
menu "Power management options"
source "drivers/acpi/Kconfig"
endmenu
endif

source "fs/Kconfig"

source "security/Kconfig"

source "crypto/Kconfig"

source "lib/Kconfig"

source "arch/xen/Kconfig.debug"
```
