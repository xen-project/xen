## linux-2.6-xen-sparse/drivers/Kconfig
```kconfig
# drivers/Kconfig

menu "Device Drivers"

source "drivers/base/Kconfig"

if !XEN || XEN_PHYSDEV_ACCESS

source "drivers/connector/Kconfig"

source "drivers/mtd/Kconfig"

source "drivers/parport/Kconfig"

source "drivers/pnp/Kconfig"
endif

source "drivers/block/Kconfig"

if !XEN || XEN_PHYSDEV_ACCESS
source "drivers/ide/Kconfig"
endif

source "drivers/scsi/Kconfig"

if !XEN || XEN_PHYSDEV_ACCESS
source "drivers/cdrom/Kconfig"
endif

source "drivers/md/Kconfig"

if !XEN || XEN_PHYSDEV_ACCESS
source "drivers/message/fusion/Kconfig"

source "drivers/ieee1394/Kconfig"

source "drivers/message/i2o/Kconfig"

source "drivers/macintosh/Kconfig"
endif

source "drivers/net/Kconfig"

if !XEN || XEN_PHYSDEV_ACCESS
source "drivers/isdn/Kconfig"

source "drivers/telephony/Kconfig"

# input before char - char/joystick depends on it. As does USB.

source "drivers/input/Kconfig"

source "drivers/char/Kconfig"

source "drivers/i2c/Kconfig"

source "drivers/spi/Kconfig"

source "drivers/w1/Kconfig"

source "drivers/hwmon/Kconfig"

source "drivers/misc/Kconfig"

source "drivers/mfd/Kconfig"

source "drivers/media/Kconfig"

source "drivers/video/Kconfig"

source "sound/Kconfig"

source "drivers/usb/Kconfig"

source "drivers/mmc/Kconfig"

source "drivers/infiniband/Kconfig"
endif

if XEN && !XEN_PHYSDEV_ACCESS
# Gross hack. Fix later by allowing unprivileged guest to include
# char/Kconfig without breaking the build.
config UNIX98_PTYS
        bool
        default y
config LEGACY_PTYS
        bool
        default y
config LEGACY_PTY_COUNT
        int
        default "256"
endif

source "drivers/sn/Kconfig"

source "drivers/edac/Kconfig"

endmenu
```

## linux-2.6-xen-sparse/drivers/char/tpm/Kconfig
```kconfig
#
# TPM device configuration
#

menu "TPM devices"

config TCG_TPM
	tristate "TPM Hardware Support"
	depends on EXPERIMENTAL && (PCI || XEN)
	---help---
	  If you have a TPM security chip in your system, which
	  implements the Trusted Computing Group's specification,
	  say Yes and it will be accessible from within Linux.  For
	  more information see <http://www.trustedcomputinggroup.org>. 
	  An implementation of the Trusted Software Stack (TSS), the 
	  userspace enablement piece of the specification, can be 
	  obtained at: <http://sourceforge.net/projects/trousers>.  To 
	  compile this driver as a module, choose M here; the module 
	  will be called tpm. If unsure, say N.

config TCG_NSC
	tristate "National Semiconductor TPM Interface"
	depends on TCG_TPM && !XEN_UNPRIVILEGED_GUEST
	---help---
	  If you have a TPM security chip from National Semicondutor 
	  say Yes and it will be accessible from within Linux.  To 
	  compile this driver as a module, choose M here; the module 
	  will be called tpm_nsc.

config TCG_ATMEL
	tristate "Atmel TPM Interface"
	depends on TCG_TPM && !XEN_UNPRIVILEGED_GUEST
	---help---
	  If you have a TPM security chip from Atmel say Yes and it 
	  will be accessible from within Linux.  To compile this driver 
	  as a module, choose M here; the module will be called tpm_atmel.

config TCG_XEN
	tristate "XEN TPM Interface"
	depends on TCG_TPM && XEN && XEN_TPMDEV_FRONTEND
	---help---
	  If you want to make TPM support available to a Xen
	  user domain, say Yes and it will
          be accessible from within Linux. To compile this driver
          as a module, choose M here; the module will be called
          tpm_xen.

endmenu
```

## linux-2.6-xen-sparse/drivers/char/tpm/Kconfig.domU
```kconfig
#
# TPM device configuration
#

menu "TPM devices"

config TCG_TPM
	tristate "TPM Support for XEN"
	depends on ARCH_XEN && !XEN_PHYSDEV_ACCESS
	---help---
	  If you want to make TPM security available in your system,
	  say Yes and it will be accessible from within a user domain.  For
	  more information see <http://www.trustedcomputinggroup.org>.
	  An implementation of the Trusted Software Stack (TSS), the
	  userspace enablement piece of the specification, can be
	  obtained at: <http://sourceforge.net/projects/trousers>.  To
	  compile this driver as a module, choose M here; the module
	  will be called tpm. If unsure, say N.

config TCG_XEN
	tristate "XEN TPM Interface"
	depends on TCG_TPM && ARCH_XEN && XEN_TPMDEV_FRONTEND
	---help---
	  If you want to make TPM support available to a Xen
	  user domain, say Yes and it will
          be accessible from within Linux. To compile this driver
          as a module, choose M here; the module will be called
          tpm_xen.

endmenu
```

## linux-2.6-xen-sparse/drivers/xen/Kconfig
```kconfig
#
# This Kconfig describe xen options
#

mainmenu "Xen Configuration"

config XEN
	bool
	default y if X86_XEN || X86_64_XEN
	help
	  This is the Linux Xen port.

if XEN
config XEN_INTERFACE_VERSION
	hex
	default 0x00030205

menu "XEN"

config XEN_PRIVILEGED_GUEST
	bool "Privileged Guest (domain 0)"
	depends XEN
	default n
	help
	  Support for privileged operation (domain 0)

config XEN_UNPRIVILEGED_GUEST
	bool
	default !XEN_PRIVILEGED_GUEST

config XEN_PRIVCMD
	bool
	depends on PROC_FS
	default y

config XEN_XENBUS_DEV
	bool
	depends on PROC_FS
	default y

config XEN_BACKEND
        tristate "Backend driver support"
        default y
        help
          Support for backend device drivers that provide I/O services
          to other virtual machines.

config XEN_BLKDEV_BACKEND
	tristate "Block-device backend driver"
        depends on XEN_BACKEND
	default y
	help
	  The block-device backend driver allows the kernel to export its
	  block devices to other guests via a high-performance shared-memory
	  interface.

config XEN_BLKDEV_TAP
	tristate "Block-device tap backend driver"
	depends on XEN_BACKEND
	default XEN_PRIVILEGED_GUEST
	help
	  The block tap driver is an alternative to the block back driver 
          and allows VM block requests to be redirected to userspace through
          a device interface.  The tap allows user-space development of 
          high-performance block backends, where disk images may be implemented
          as files, in memory, or on other hosts across the network.  This 
	  driver can safely coexist with the existing blockback driver.

config XEN_NETDEV_BACKEND
	tristate "Network-device backend driver"
        depends on XEN_BACKEND && NET
	default y
	help
	  The network-device backend driver allows the kernel to export its
	  network devices to other guests via a high-performance shared-memory
	  interface.

config XEN_NETDEV_PIPELINED_TRANSMITTER
	bool "Pipelined transmitter (DANGEROUS)"
	depends on XEN_NETDEV_BACKEND
	default n
	help
	  If the net backend is a dumb domain, such as a transparent Ethernet
	  bridge with no local IP interface, it is safe to say Y here to get
	  slightly lower network overhead.
	  If the backend has a local IP interface; or may be doing smart things
	  like reassembling packets to perform firewall filtering; or if you
	  are unsure; or if you experience network hangs when this option is
	  enabled; then you must say N here.

config XEN_NETDEV_LOOPBACK
	tristate "Network-device loopback driver"
	depends on XEN_NETDEV_BACKEND
	default y
	help
	  A two-interface loopback device to emulate a local netfront-netback
	  connection.

config XEN_PCIDEV_BACKEND
	tristate "PCI-device backend driver"
	depends on PCI && XEN_BACKEND
	default XEN_PRIVILEGED_GUEST
	help
	  The PCI device backend driver allows the kernel to export arbitrary
	  PCI devices to other guests. If you select this to be a module, you
	  will need to make sure no other driver has bound to the device(s)
	  you want to make visible to other guests.

choice
	prompt "PCI Backend Mode"
	depends on XEN_PCIDEV_BACKEND
	default XEN_PCIDEV_BACKEND_VPCI

config XEN_PCIDEV_BACKEND_VPCI
	bool "Virtual PCI"
	---help---
	  This PCI Backend hides the true PCI topology and makes the frontend
	  think there is a single PCI bus with only the exported devices on it.
	  For example, a device at 03:05.0 will be re-assigned to 00:00.0. A
	  second device at 02:1a.1 will be re-assigned to 00:01.1.

config XEN_PCIDEV_BACKEND_PASS
	bool "Passthrough"
	---help---
	  This PCI Backend provides a real view of the PCI topology to the
	  frontend (for example, a device at 06:01.b will still appear at
	  06:01.b to the frontend). This is similar to how Xen 2.0.x exposed
	  PCI devices to its driver domains. This may be required for drivers
	  which depend on finding their hardward in certain bus/slot
	  locations.

config XEN_PCIDEV_BACKEND_SLOT
	bool "Slot"
	---help---
	  This PCI Backend hides the true PCI topology and makes the frontend
	  think there is a single PCI bus with only the exported devices on it.
	  Contrary to the virtual PCI backend, a function becomes a new slot.
	  For example, a device at 03:05.2 will be re-assigned to 00:00.0. A
	  second device at 02:1a.1 will be re-assigned to 00:01.0.

endchoice

config XEN_PCIDEV_BE_DEBUG
	bool "PCI Backend Debugging"
	depends on XEN_PCIDEV_BACKEND
	default n

config XEN_TPMDEV_BACKEND
	tristate "TPM-device backend driver"
        depends on XEN_BACKEND
	default n
	help
	  The TPM-device backend driver

config XEN_BLKDEV_FRONTEND
	tristate "Block-device frontend driver"
	depends on XEN
	default y
	help
	  The block-device frontend driver allows the kernel to access block
	  devices mounted within another guest OS. Unless you are building a
	  dedicated device-driver domain, or your master control domain
	  (domain 0), then you almost certainly want to say Y here.

config XEN_NETDEV_FRONTEND
	tristate "Network-device frontend driver"
	depends on XEN && NET
	default y
	help
	  The network-device frontend driver allows the kernel to access
	  network interfaces within another guest OS. Unless you are building a
	  dedicated device-driver domain, or your master control domain
	  (domain 0), then you almost certainly want to say Y here.

config XEN_FRAMEBUFFER
	tristate "Framebuffer-device frontend driver"
	depends on XEN && FB
	select FB_CFB_FILLRECT
	select FB_CFB_COPYAREA
	select FB_CFB_IMAGEBLIT
	default y
	help
	  The framebuffer-device frontend drivers allows the kernel to create a
	  virtual framebuffer.  This framebuffer can be viewed in another
	  domain.  Unless this domain has access to a real video card, you
	  probably want to say Y here.

config XEN_KEYBOARD
	tristate "Keyboard-device frontend driver"
	depends on XEN && XEN_FRAMEBUFFER && INPUT
	default y
	help
	  The keyboard-device frontend driver allows the kernel to create a
	  virtual keyboard.  This keyboard can then be driven by another
	  domain.  If you've said Y to CONFIG_XEN_FRAMEBUFFER, you probably
	  want to say Y here.

config XEN_SCRUB_PAGES
	bool "Scrub memory before freeing it to Xen"
	default y
	help
	  Erase memory contents before freeing it back to Xen's global
	  pool. This ensures that any secrets contained within that
	  memory (e.g., private keys) cannot be found by other guests that
	  may be running on the machine. Most people will want to say Y here.
	  If security is not a concern then you may increase performance by
	  saying N.

config XEN_DISABLE_SERIAL
	bool "Disable serial port drivers"
	default y
	help
	  Disable serial port drivers, allowing the Xen console driver
	  to provide a serial console at ttyS0.

config XEN_SYSFS
	tristate "Export Xen attributes in sysfs"
	depends on SYSFS
	default y
	help
	  Xen hypervisor attributes will show up under /sys/hypervisor/.

choice
	prompt "Xen version compatibility"
	default XEN_COMPAT_030002_AND_LATER

	config XEN_COMPAT_030002_AND_LATER
		bool "3.0.2 and later"

	config XEN_COMPAT_030004_AND_LATER
		bool "3.0.4 and later"

	config XEN_COMPAT_LATEST_ONLY
		bool "no compatibility code"

endchoice

config XEN_COMPAT_030002
	bool
	default XEN_COMPAT_030002_AND_LATER

config XEN_COMPAT_030004
	bool
	default XEN_COMPAT_030002_AND_LATER || XEN_COMPAT_030004_AND_LATER

endmenu

config HAVE_IRQ_IGNORE_UNHANDLED
	bool
	default y

config NO_IDLE_HZ
	bool
	default y

config XEN_UTIL
	bool
	default y

config XEN_BALLOON
	bool
	default y

config XEN_DEVMEM
	bool
	default y

config XEN_REBOOT
	bool
	default y

config XEN_SMPBOOT
	bool
	default y
	depends on SMP

endif
```

## linux-2.6-xen-sparse/drivers/xen/blkfront/Kconfig
```kconfig
config XENBLOCK
	tristate "Block device driver"
	depends on ARCH_XEN
	help
	  Block device driver for Xen
```

## linux-2.6.11-xen-sparse/arch/xen/Kconfig.drivers
```kconfig
# arch/xen/Kconfig.drivers

menu "Device Drivers"

source "drivers/base/Kconfig"

if XEN_PHYSDEV_ACCESS
source "drivers/mtd/Kconfig"
source "drivers/parport/Kconfig"
source "drivers/pnp/Kconfig"
endif

source "drivers/block/Kconfig"

if XEN_PHYSDEV_ACCESS
source "drivers/ide/Kconfig"
endif

source "drivers/scsi/Kconfig"

if XEN_PHYSDEV_ACCESS
source "drivers/cdrom/Kconfig"
endif

source "drivers/md/Kconfig"

if XEN_PHYSDEV_ACCESS
source "drivers/message/fusion/Kconfig"
source "drivers/ieee1394/Kconfig"
source "drivers/message/i2o/Kconfig"
endif

source "net/Kconfig"

if XEN_PHYSDEV_ACCESS
source "drivers/isdn/Kconfig"
source "drivers/telephony/Kconfig"
source "drivers/input/Kconfig"
source "drivers/char/Kconfig"
source "drivers/i2c/Kconfig"
source "drivers/w1/Kconfig"
source "drivers/misc/Kconfig"
source "drivers/media/Kconfig"
source "drivers/video/Kconfig"
source "sound/Kconfig"
source "drivers/usb/Kconfig"
source "drivers/mmc/Kconfig"
source "drivers/infiniband/Kconfig"
endif

if !XEN_PHYSDEV_ACCESS

menu "Character devices"

config UNIX98_PTYS
	bool
	default y

config LEGACY_PTYS
	bool "Legacy (BSD) PTY support"
	default y
	---help---
	  A pseudo terminal (PTY) is a software device consisting of two
	  halves: a master and a slave. The slave device behaves identical to
	  a physical terminal; the master device is used by a process to
	  read data from and write data to the slave, thereby emulating a
	  terminal. Typical programs for the master side are telnet servers
	  and xterms.

	  Linux has traditionally used the BSD-like names /dev/ptyxx
	  for masters and /dev/ttyxx for slaves of pseudo
	  terminals. This scheme has a number of problems, including
	  security.  This option enables these legacy devices; on most
	  systems, it is safe to say N.


config LEGACY_PTY_COUNT
	int "Maximum number of legacy PTY in use"
	depends on LEGACY_PTYS
	range 1 256
	default "256"
	---help---
	  The maximum number of legacy PTYs that can be used at any one time.
	  The default is 256, and should be more than enough.  Embedded
	  systems may want to reduce this to save memory.

	  When not in use, each legacy PTY occupies 12 bytes on 32-bit
	  architectures and 24 bytes on 64-bit architectures.

endmenu

endif

endmenu
```

## linux-2.6.11-xen-sparse/drivers/xen/netfront/Kconfig
```kconfig
config XENNET
	tristate "Xen network driver"
	depends on NETDEVICES && ARCH_XEN
	help
	  Network driver for Xen
```
