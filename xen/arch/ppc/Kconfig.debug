## xen/drivers/Kconfig
```kconfig
menu "Device Drivers"

source "drivers/acpi/Kconfig"

source "drivers/char/Kconfig"

source "drivers/cpufreq/Kconfig"

source "drivers/passthrough/Kconfig"

source "drivers/pci/Kconfig"

source "drivers/video/Kconfig"

config HAS_VPCI
	bool
	select HAS_PCI

config HAS_VPCI_GUEST_SUPPORT
	bool
	select HAS_VPCI

endmenu
```

## xen/drivers/acpi/Kconfig
```kconfig
config ACPI
	bool

config ACPI_LEGACY_TABLES_LOOKUP
	bool

config ACPI_NUMA
	bool
	select NUMA
```

## xen/drivers/char/Kconfig
```kconfig
config HAS_NS16550
	bool "NS16550 UART driver" if ARM
	default n if RISCV
	default y
	help
	  This selects the 16550-series UART support. For most systems, say Y.

config HAS_CADENCE_UART
	bool "Xilinx Cadence UART driver"
	default y
	depends on ARM_64
	help
	  This selects the Xilinx Zynq Cadence UART. If you have a Xilinx Zynq
	  based board, say Y.

config HAS_IMX_LPUART
	bool "i.MX LPUART driver"
	default y
	depends on ARM_64
	help
	  This selects the i.MX LPUART. If you have i.MX8QM based board, say Y.

config HAS_MVEBU
	bool "Marvell MVEBU UART driver"
	default y
	depends on ARM_64
	help
	  This selects the Marvell MVEBU UART. If you have a ARMADA 3700
	  based board, say Y.

config HAS_MESON
	bool "Amlogic MESON UART driver"
	default y
	depends on ARM_64
	help
	  This selects the Amlogic MESON UART. If you have a Amlogic based
	  board, say Y.

config HAS_PL011
	bool "ARM PL011 UART driver"
	default y
	depends on ARM
	help
	  This selects the ARM(R) AMBA(R) PrimeCell PL011 UART. If you have
	  an Integrator/PP2, Integrator/CP or Versatile platform, say Y.

config HAS_EXYNOS4210
	bool "Samsung Exynos 4210 UART driver"
	default y
	depends on ARM_32
	help
	  This selects the Samsung Exynos 4210 UART. If you have a Samsung
	  Exynos based board, say Y.

config HAS_OMAP
	bool "Texas Instruments OMAP UART driver"
	default y
	depends on ARM
	help
	  This selects the Texas Instruments OMAP UART. If you have a Texas
	  Instruments based CPU, say Y.

config HAS_SCIF
	bool "SuperH SCI(F) UART driver"
	default y
	depends on ARM
	help
	  This selects the SuperH SCI(F) UART. If you have a SuperH based board,
	  or Renesas R-Car Gen 2/3 based board say Y.

config HAS_EHCI
	bool
	depends on X86
	help
	  This selects the USB based EHCI debug port to be used as a UART. If
	  you have an x86 based system with USB, say Y.

config SERIAL_TX_BUFSIZE
	int "Size of the transmit serial buffer"
	default 32768
	help
	  Controls the default size of the transmit buffer (in bytes) used by
	  the serial driver.  Note the value provided will be rounded down to
	  the nearest power of 2.

	  Default value is 32768 (32KiB).

config XHCI
	bool "XHCI DbC UART driver"
	depends on X86
	help
	  This selects the USB based XHCI debug capability to be usable as a UART.
	  Enabling this option makes Xen use extra ~230KiB memory, even if XHCI UART
	  is not selected.
	  If you have an x86 based system with USB3, say Y.
```

## xen/drivers/passthrough/Kconfig
```kconfig
config HAS_PASSTHROUGH
	bool

if ARM
config ARM_SMMU
	bool "ARM SMMUv1 and v2 driver"
	default y
	help
	  Support for implementations of the ARM System MMU architecture
	  versions 1 and 2.

	  Say Y here if your SoC includes an IOMMU device implementing the
	  ARM SMMU architecture.

config ARM_SMMU_V3
	bool "ARM Ltd. System MMU Version 3 (SMMUv3) Support" if EXPERT
	depends on ARM_64 && (!ACPI || BROKEN)
	help
	 Support for implementations of the ARM System MMU architecture
	 version 3. Driver is in experimental stage and should not be used in
	 production.

	 Say Y here if your system includes an IOMMU device implementing
	 the ARM SMMUv3 architecture.

config IPMMU_VMSA
	bool "Renesas IPMMU-VMSA found in R-Car Gen3/Gen4 SoCs"
	depends on ARM_64
	help
	  Support for implementations of the Renesas IPMMU-VMSA found
	  in R-Car Gen3/Gen4 SoCs.

	  Say Y here if you are using newest R-Car Gen3 SoCs revisions
	  (H3 ES3.0, M3-W+, etc) or Gen4 SoCs which IPMMU hardware supports stage 2
	  translation table format and is able to use CPU's P2M table as is.

endif

config AMD_IOMMU
	bool "AMD IOMMU" if EXPERT
	depends on X86
	default y
	help
	  Enables I/O virtualization on platforms that implement the
	  AMD I/O Virtualization Technology (IOMMU).

	  If your system includes an IOMMU implementing AMD-Vi, say Y.
	  This is required if your system has more than 254 CPUs.
	  If in doubt, say Y.

config INTEL_IOMMU
	bool "Intel VT-d" if EXPERT
	depends on X86
	default y
	help
	  Enables I/O virtualization on platforms that implement the
	  Intel Virtualization Technology for Directed I/O (Intel VT-d).

	  If your system includes an IOMMU implementing Intel VT-d, say Y.
	  This is required if your system has more than 254 CPUs.
	  If in doubt, say Y.

config IOMMU_FORCE_PT_SHARE
	bool

choice
	prompt "IOMMU device quarantining default behavior"
	depends on HAS_PCI
	default IOMMU_QUARANTINE_BASIC
	help
	  When a PCI device is assigned to an untrusted domain, it is possible
	  for that domain to program the device to DMA to an arbitrary address.
	  The IOMMU is used to protect the host from malicious DMA by making
	  sure that the device addresses can only target memory assigned to the
	  guest.  However, when the guest domain is torn down, assigning the
	  device back to the hardware domain would allow any in-flight DMA to
	  potentially target critical host data.  To avoid this, quarantining
	  should be enabled.  Quarantining can be done in two ways: In its basic
	  form, all in-flight DMA will simply be forced to encounter IOMMU
	  faults.  Since there are systems where doing so can cause host lockup,
	  an alternative form is available where writes to memory will be made
	  fault, but reads will be directed to a scratch page.  The implication
	  here is that such reads will go unnoticed, i.e. an admin may not
	  become aware of the underlying problem.

	config IOMMU_QUARANTINE_NONE
		bool "none"
	config IOMMU_QUARANTINE_BASIC
		bool "basic"
	config IOMMU_QUARANTINE_SCRATCH_PAGE
		bool "scratch page"
endchoice
```

## xen/drivers/video/Kconfig
```kconfig
config VIDEO
	bool

config VGA
	bool "VGA support" if !PV_SHIM_EXCLUSIVE
	select VIDEO
	depends on X86
	default y if !PV_SHIM_EXCLUSIVE
	---help---
	  Enable VGA output for the Xen hypervisor.

	  If unsure, say Y.

config HAS_ARM_HDLCD
	bool
```

## xenolinux-2.4.21-pre4-sparse/arch/xeno/config.in
```kconfig
#
# For a description of the syntax of this configuration file,
# see Documentation/kbuild/config-language.txt.
#
mainmenu_name "Linux Kernel Configuration"

define_bool CONFIG_XENO y

define_bool CONFIG_X86 y
define_bool CONFIG_ISA y
define_bool CONFIG_SBUS n

define_bool CONFIG_UID16 y

mainmenu_option next_comment
comment 'Code maturity level options'
bool 'Prompt for development and/or incomplete code/drivers' CONFIG_EXPERIMENTAL
endmenu

mainmenu_option next_comment
comment 'Loadable module support'
bool 'Enable loadable module support' CONFIG_MODULES
if [ "$CONFIG_MODULES" = "y" ]; then
   bool '  Set version information on all module symbols' CONFIG_MODVERSIONS
   bool '  Kernel module loader' CONFIG_KMOD
fi
endmenu

mainmenu_option next_comment
comment 'Processor type and features'
choice 'Processor family' \
	"Pentium-Pro/Celeron/Pentium-II		CONFIG_M686 \
	 Pentium-III/Celeron(Coppermine)	CONFIG_MPENTIUMIII \
	 Pentium-4				CONFIG_MPENTIUM4 \
	 Athlon/Duron/K7			CONFIG_MK7" Pentium-Pro

   define_bool CONFIG_X86_WP_WORKS_OK y
   define_bool CONFIG_X86_INVLPG y
   define_bool CONFIG_X86_CMPXCHG y
   define_bool CONFIG_X86_XADD y
   define_bool CONFIG_X86_BSWAP y
   define_bool CONFIG_X86_POPAD_OK y
   define_bool CONFIG_RWSEM_GENERIC_SPINLOCK n
   define_bool CONFIG_RWSEM_XCHGADD_ALGORITHM y

   define_bool CONFIG_X86_GOOD_APIC y
   define_bool CONFIG_X86_PGE y
   define_bool CONFIG_X86_USE_PPRO_CHECKSUM y
   define_bool CONFIG_X86_TSC y

if [ "$CONFIG_M686" = "y" ]; then
   define_int  CONFIG_X86_L1_CACHE_SHIFT 5
fi
if [ "$CONFIG_MPENTIUMIII" = "y" ]; then
   define_int  CONFIG_X86_L1_CACHE_SHIFT 5
fi
if [ "$CONFIG_MPENTIUM4" = "y" ]; then
   define_int  CONFIG_X86_L1_CACHE_SHIFT 7
fi
if [ "$CONFIG_MK7" = "y" ]; then
   define_int  CONFIG_X86_L1_CACHE_SHIFT 6
   define_bool CONFIG_X86_USE_3DNOW y
fi

choice 'High Memory Support' \
	"off    CONFIG_NOHIGHMEM \
	 4GB    CONFIG_HIGHMEM4G \
	 64GB   CONFIG_HIGHMEM64G" off
if [ "$CONFIG_HIGHMEM4G" = "y" ]; then
   define_bool CONFIG_HIGHMEM y
fi
if [ "$CONFIG_HIGHMEM64G" = "y" ]; then
   define_bool CONFIG_HIGHMEM y
   define_bool CONFIG_X86_PAE y
fi

#bool 'Symmetric multi-processing support' CONFIG_SMP
#if [ "$CONFIG_SMP" = "y" -a "$CONFIG_X86_CMPXCHG" = "y" ]; then
#   define_bool CONFIG_HAVE_DEC_LOCK y
#fi
endmenu

mainmenu_option next_comment
comment 'General setup'

bool 'Networking support' CONFIG_NET

bool 'System V IPC' CONFIG_SYSVIPC
bool 'BSD Process Accounting' CONFIG_BSD_PROCESS_ACCT
bool 'Sysctl support' CONFIG_SYSCTL
if [ "$CONFIG_PROC_FS" = "y" ]; then
   choice 'Kernel core (/proc/kcore) format' \
	"ELF		CONFIG_KCORE_ELF	\
	 A.OUT		CONFIG_KCORE_AOUT" ELF
fi
tristate 'Kernel support for a.out binaries' CONFIG_BINFMT_AOUT
tristate 'Kernel support for ELF binaries' CONFIG_BINFMT_ELF
tristate 'Kernel support for MISC binaries' CONFIG_BINFMT_MISC

endmenu

if [ "$CONFIG_NET" = "y" ]; then
   source net/Config.in
fi

source drivers/block/Config.in
define_bool CONFIG_BLK_DEV_IDE_MODES n
define_bool CONFIG_BLK_DEV_HD n

source fs/Config.in

mainmenu_option next_comment
comment 'Kernel hacking'

bool 'Kernel debugging' CONFIG_DEBUG_KERNEL
if [ "$CONFIG_DEBUG_KERNEL" != "n" ]; then
   bool '  Debug high memory support' CONFIG_DEBUG_HIGHMEM
   bool '  Debug memory allocations' CONFIG_DEBUG_SLAB
   bool '  Memory mapped I/O debugging' CONFIG_DEBUG_IOVIRT
   bool '  Magic SysRq key' CONFIG_MAGIC_SYSRQ
   bool '  Spinlock debugging' CONFIG_DEBUG_SPINLOCK
   bool '  Verbose BUG() reporting (adds 70K)' CONFIG_DEBUG_BUGVERBOSE
   bool '  Load all symbols for debugging' CONFIG_KALLSYMS
   bool '  Compile the kernel with frame pointers' CONFIG_FRAME_POINTER
fi

endmenu
```

## xenolinux-2.4.25-sparse/arch/xeno/config.in
```kconfig
#
# For a description of the syntax of this configuration file,
# see Documentation/kbuild/config-language.txt.
#
mainmenu_name "Linux Kernel Configuration"

define_bool CONFIG_XENO y

define_bool CONFIG_X86 y
define_bool CONFIG_ISA y
define_bool CONFIG_SBUS n

define_bool CONFIG_UID16 y

mainmenu_option next_comment
comment 'Xenolinux'
bool 'Support for privileged operations (domain 0)' CONFIG_XENO_PRIV
endmenu
# The IBM S/390 patch needs this.
define_bool CONFIG_NO_IDLE_HZ y

mainmenu_option next_comment
comment 'Code maturity level options'
bool 'Prompt for development and/or incomplete code/drivers' CONFIG_EXPERIMENTAL
endmenu

mainmenu_option next_comment
comment 'Loadable module support'
bool 'Enable loadable module support' CONFIG_MODULES
if [ "$CONFIG_MODULES" = "y" ]; then
   bool '  Set version information on all module symbols' CONFIG_MODVERSIONS
   bool '  Kernel module loader' CONFIG_KMOD
fi
endmenu

mainmenu_option next_comment
comment 'Processor type and features'
choice 'Processor family' \
	"Pentium-Pro/Celeron/Pentium-II		CONFIG_M686 \
	 Pentium-III/Celeron(Coppermine)	CONFIG_MPENTIUMIII \
	 Pentium-4				CONFIG_MPENTIUM4 \
	 Athlon/Duron/K7			CONFIG_MK7 \
	 Opteron/Athlon64/Hammer/K8             CONFIG_MK8 \
	 VIA-C3-2                               CONFIG_MVIAC3_2" Pentium-Pro

   define_bool CONFIG_X86_WP_WORKS_OK y
   define_bool CONFIG_X86_INVLPG y
   define_bool CONFIG_X86_CMPXCHG y
   define_bool CONFIG_X86_XADD y
   define_bool CONFIG_X86_BSWAP y
   define_bool CONFIG_X86_POPAD_OK y
   define_bool CONFIG_RWSEM_GENERIC_SPINLOCK n
   define_bool CONFIG_RWSEM_XCHGADD_ALGORITHM y

   define_bool CONFIG_X86_GOOD_APIC y
   define_bool CONFIG_X86_PGE y
   define_bool CONFIG_X86_USE_PPRO_CHECKSUM y
   define_bool CONFIG_X86_TSC y

if [ "$CONFIG_M686" = "y" ]; then
   define_int  CONFIG_X86_L1_CACHE_SHIFT 5
fi
if [ "$CONFIG_MPENTIUMIII" = "y" ]; then
   define_int  CONFIG_X86_L1_CACHE_SHIFT 5
fi
if [ "$CONFIG_MPENTIUM4" = "y" ]; then
   define_int  CONFIG_X86_L1_CACHE_SHIFT 7
fi
if [ "$CONFIG_MK8" = "y" ]; then
   define_bool CONFIG_MK7 y
fi
if [ "$CONFIG_MK7" = "y" ]; then
   define_int  CONFIG_X86_L1_CACHE_SHIFT 6
   define_bool CONFIG_X86_USE_3DNOW y
fi
if [ "$CONFIG_MVIAC3_2" = "y" ]; then
   define_int  CONFIG_X86_L1_CACHE_SHIFT 5
fi

if [ "$CONFIG_EXPERIMENTAL" = "y" ]; then
   tristate 'BIOS Enhanced Disk Drive calls determine boot disk (EXPERIMENTAL)' CONFIG_EDD
fi

choice 'High Memory Support' \
	"off    CONFIG_NOHIGHMEM \
	 4GB    CONFIG_HIGHMEM4G \
	 64GB   CONFIG_HIGHMEM64G" off
if [ "$CONFIG_HIGHMEM4G" = "y" ]; then
   define_bool CONFIG_HIGHMEM y
fi
if [ "$CONFIG_HIGHMEM64G" = "y" ]; then
   define_bool CONFIG_HIGHMEM y
   define_bool CONFIG_X86_PAE y
fi

#bool 'Symmetric multi-processing support' CONFIG_SMP
#if [ "$CONFIG_SMP" = "y" -a "$CONFIG_X86_CMPXCHG" = "y" ]; then
#   define_bool CONFIG_HAVE_DEC_LOCK y
#fi
endmenu

mainmenu_option next_comment
comment 'General setup'

bool 'Networking support' CONFIG_NET

bool 'PCI support' CONFIG_PCI
if [ "$CONFIG_PCI" = "y" ]; then
   tristate '    3c590/3c900 series (592/595/597) "Vortex/Boomerang" support' CONFIG_VORTEX
fi
source drivers/pci/Config.in

bool 'System V IPC' CONFIG_SYSVIPC
bool 'BSD Process Accounting' CONFIG_BSD_PROCESS_ACCT
bool 'Sysctl support' CONFIG_SYSCTL
if [ "$CONFIG_PROC_FS" = "y" ]; then
   choice 'Kernel core (/proc/kcore) format' \
	"ELF		CONFIG_KCORE_ELF	\
	 A.OUT		CONFIG_KCORE_AOUT" ELF
fi
tristate 'Kernel support for a.out binaries' CONFIG_BINFMT_AOUT
tristate 'Kernel support for ELF binaries' CONFIG_BINFMT_ELF
tristate 'Kernel support for MISC binaries' CONFIG_BINFMT_MISC
bool 'Select task to kill on out of memory condition' CONFIG_OOM_KILLER

endmenu

if [ "$CONFIG_NET" = "y" ]; then
   source net/Config.in
fi


#
# Block device driver configuration
#
mainmenu_option next_comment
comment 'Block devices'
tristate 'Loopback device support' CONFIG_BLK_DEV_LOOP
dep_tristate 'Network block device support' CONFIG_BLK_DEV_NBD $CONFIG_NET
tristate 'RAM disk support' CONFIG_BLK_DEV_RAM
if [ "$CONFIG_BLK_DEV_RAM" = "y" -o "$CONFIG_BLK_DEV_RAM" = "m" ]; then
   int '  Default RAM disk size' CONFIG_BLK_DEV_RAM_SIZE 4096
fi
dep_bool '  Initial RAM disk (initrd) support' CONFIG_BLK_DEV_INITRD $CONFIG_BLK_DEV_RAM
bool 'Per partition statistics in /proc/partitions' CONFIG_BLK_STATS
bool 'XenoLinux virtual block device support' CONFIG_XENOLINUX_BLOCK
#endmenu
define_bool CONFIG_BLK_DEV_HD n
endmenu

source drivers/char/Config.in

source fs/Config.in

mainmenu_option next_comment
comment 'Console drivers'

bool 'Xen console support' CONFIG_XEN_CONSOLE

if [ "$CONFIG_VT" = "y" ]; then
   bool 'VGA text console' CONFIG_VGA_CONSOLE
   bool 'Dummy console' CONFIG_DUMMY_CONSOLE 
fi
endmenu

mainmenu_option next_comment
comment 'Kernel hacking'

bool 'Kernel debugging' CONFIG_DEBUG_KERNEL
if [ "$CONFIG_DEBUG_KERNEL" != "n" ]; then
   bool '  Debug high memory support' CONFIG_DEBUG_HIGHMEM
   bool '  Debug memory allocations' CONFIG_DEBUG_SLAB
   bool '  Memory mapped I/O debugging' CONFIG_DEBUG_IOVIRT
   bool '  Magic SysRq key' CONFIG_MAGIC_SYSRQ
   bool '  Spinlock debugging' CONFIG_DEBUG_SPINLOCK
   bool '  Verbose BUG() reporting (adds 70K)' CONFIG_DEBUG_BUGVERBOSE
   bool '  Load all symbols for debugging' CONFIG_KALLSYMS
   bool '  Compile the kernel with frame pointers' CONFIG_FRAME_POINTER
fi

int 'Kernel messages buffer length shift (0 = default)' CONFIG_LOG_BUF_SHIFT 0

endmenu

source crypto/Config.in
source lib/Config.in
```
