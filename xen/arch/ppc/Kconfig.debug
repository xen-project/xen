## xen/arch/ppc/Kconfig.debug
```kconfig
config EARLY_PRINTK
    bool "Enable early printk"
    default DEBUG
    help
      Enables early printk debug messages
```

## xen/arch/ppc/configs/ppc64_defconfig
```kconfig
# CONFIG_GRANT_TABLE is not set
# CONFIG_SPECULATIVE_HARDEN_ARRAY is not set
# CONFIG_VM_EVENT is not set

CONFIG_PPC64=y
CONFIG_DEBUG=y
CONFIG_DEBUG_INFO=y
CONFIG_EARLY_PRINTK=y
CONFIG_EXPERT=y
```

## xen/arch/riscv/Kconfig
```kconfig
config RISCV
	def_bool y
	select FUNCTION_ALIGNMENT_16B
	select GENERIC_BUG_FRAME
	select HAS_DEVICE_TREE
	select HAS_PMAP
	select HAS_UBSAN
	select HAS_VMAP

config RISCV_64
	def_bool y
	select 64BIT
	select HAS_SVPBMT

config ARCH_DEFCONFIG
	string
	default "arch/riscv/configs/tiny64_defconfig"

config HAS_SVPBMT
	bool

menu "Architecture Features"

source "arch/Kconfig"

endmenu

menu "ISA Selection"

config RISCV_ISA_C
	bool "Compressed extension"
	default y
	help
	  Add "C" to the ISA subsets that the toolchain is allowed to
	  emit when building Xen, which results in compressed instructions
	  in the Xen binary.

	  If unsure, say Y.

endmenu

source "arch/riscv/platforms/Kconfig"

source "common/Kconfig"

source "drivers/Kconfig"
```

## xen/arch/riscv/configs/tiny64_defconfig
```kconfig
# CONFIG_BOOT_TIME_CPUPOOLS is not set
# CONFIG_GRANT_TABLE is not set
# CONFIG_MEM_ACCESS is not set
# CONFIG_COVERAGE is not set
# CONFIG_LIVEPATCH is not set
# CONFIG_XSM is not set

CONFIG_RISCV_64=y
CONFIG_DEBUG=y
CONFIG_DEBUG_INFO=y
CONFIG_EXPERT=y
CONFIG_QEMU_PLATFORM=y
```

## xen/arch/riscv/platforms/Kconfig
```kconfig
config QEMU_PLATFORM
	bool "QEMU based platform support"
	help
	  Enable all the required drivers for QEMU riscv64
	  virt emulated machine.
```

## xen/arch/x86/Kconfig
```kconfig
config X86_64
	def_bool y
	select 64BIT

config X86
	def_bool y
	select ACPI
	select ACPI_LEGACY_TABLES_LOOKUP
	select ACPI_NUMA
	select ALTERNATIVE_CALL
	select ARCH_MAP_DOMAIN_PAGE
	select ARCH_SUPPORTS_INT128
	imply CORE_PARKING
	select FUNCTION_ALIGNMENT_16B
	select GENERIC_BUG_FRAME
	select HAS_ALTERNATIVE
	select HAS_COMPAT
	select HAS_CPUFREQ
	select HAS_DIT
	select HAS_EHCI
	select HAS_EX_TABLE
	select HAS_FAST_MULTIPLY
	select HAS_IOPORTS
	select HAS_KEXEC
	select HAS_NS16550
	select HAS_PASSTHROUGH
	select HAS_PCI
	select HAS_PCI_MSI
	select HAS_PIRQ
	select HAS_SCHED_GRANULARITY
	select HAS_UBSAN
	select HAS_VMAP
	select HAS_VPCI if HVM
	select NEEDS_LIBELF

config ARCH_DEFCONFIG
	string
	default "arch/x86/configs/x86_64_defconfig"

config CC_HAS_INDIRECT_THUNK
	def_bool $(cc-option,-mindirect-branch-register) || \
	         $(cc-option,-mretpoline-external-thunk)

config HAS_AS_CET_SS
	# binutils >= 2.29 or LLVM >= 6
	def_bool $(as-instr,wrssq %rax$(comma)0;setssbsy)

config HAS_CC_CET_IBT
	# GCC >= 9 and binutils >= 2.29
	# Retpoline check to work around https://gcc.gnu.org/bugzilla/show_bug.cgi?id=93654
	def_bool $(cc-option,-fcf-protection=branch -mmanual-endbr -mindirect-branch=thunk-extern) && $(as-instr,endbr64)

menu "Architecture Features"

source "arch/x86/Kconfig.cpu"

source "arch/Kconfig"

config PV
	def_bool y
	prompt "PV support"
	help
	  Interfaces to support PV domains. These require guest kernel support
	  to run as a PV guest, but don't require any specific hardware support.

	  This option is needed if you want to run PV domains.

	  If unsure, say Y.

config PV32
	bool "Support for 32bit PV guests"
	depends on PV
	default PV_SHIM
	select COMPAT
	help
	  The 32bit PV ABI uses Ring1, an area of the x86 architecture which
	  was deprecated and mostly removed in the AMD64 spec.  As a result,
	  it occasionally conflicts with newer x86 hardware features, causing
	  overheads for Xen to maintain backwards compatibility.

	  People may wish to disable 32bit PV guests for attack surface
	  reduction, or performance reasons.  Backwards compatibility can be
	  provided via the PV Shim mechanism.

	  Note that outside of PV Shim, 32-bit PV guests are not security
	  supported anymore.

	  If unsure, use the default setting.

config PV_LINEAR_PT
       bool "Support for PV linear pagetables"
       depends on PV
       default y
       help
         Linear pagetables (also called "recursive pagetables") refers
         to the practice of a guest operating system having pagetable
         entries pointing to other pagetables of the same level (i.e.,
         allowing L2 PTEs to point to other L2 pages).  Some operating
         systems use it as a simple way to consistently map the current
         process's pagetables into its own virtual address space.

         Linux and MiniOS don't use this technique.  NetBSD and Novell
         Netware do; there may be other custom operating systems which
         do.  If you're certain you don't plan on having PV guests
         which use this feature, turning it off can reduce the attack
         surface.

         If unsure, say Y.

config HVM
	bool "HVM support"
	depends on !PV_SHIM_EXCLUSIVE
	default !PV_SHIM
	select COMPAT
	select IOREQ_SERVER
	select MEM_ACCESS_ALWAYS_ON
	help
	  Interfaces to support HVM domains.  HVM domains require hardware
	  virtualisation extensions (e.g. Intel VT-x, AMD SVM), but can boot
	  guests which have no specific Xen knowledge.

	  This option is needed if you want to run HVM or PVH domains.

	  If unsure, say Y.

config AMD_SVM
	bool "AMD-V" if EXPERT
	depends on HVM
	default y
	help
	  Enables virtual machine extensions on platforms that implement the
	  AMD Virtualization Technology (AMD-V).
	  If your system includes a processor with AMD-V support, say Y.
	  If in doubt, say Y.

config INTEL_VMX
	bool "Intel VT-x" if EXPERT
	depends on HVM
	default y
	select ARCH_VCPU_IOREQ_COMPLETION
	help
	  Enables virtual machine extensions on platforms that implement the
	  Intel Virtualization Technology (Intel VT-x).
	  If your system includes a processor with Intel VT-x support, say Y.
	  If in doubt, say Y.

config XEN_SHSTK
	bool "Supervisor Shadow Stacks"
	depends on HAS_AS_CET_SS
	default y
	help
	  Control-flow Enforcement Technology (CET) is a set of features in
	  hardware designed to combat Return-oriented Programming (ROP, also
	  call/jump COP/JOP) attacks.  Shadow Stacks are one CET feature
	  designed to provide return address protection.

	  This option arranges for Xen to use CET-SS for its own protection.
	  When CET-SS is active, 32bit PV guests cannot be used.  Backwards
	  compatiblity can be provided via the PV Shim mechanism.

config XEN_IBT
	bool "Supervisor Indirect Branch Tracking"
	depends on HAS_CC_CET_IBT
	default y
	help
	  Control-flow Enforcement Technology (CET) is a set of features in
	  hardware designed to combat Return-oriented Programming (ROP, also
	  call/jump COP/JOP) attacks.  Indirect Branch Tracking is one CET
	  feature designed to provide function pointer protection.

	  This option arranges for Xen to use CET-IBT for its own protection.

config SHADOW_PAGING
	bool "Shadow Paging"
	default !PV_SHIM_EXCLUSIVE
	depends on PV || HVM
	help

          Shadow paging is a software alternative to hardware paging support
          (Intel EPT, AMD NPT).

          It is required for:
            * Running HVM guests on hardware lacking hardware paging support
              (First-generation Intel VT-x or AMD SVM).
            * Live migration of PV guests.
            * L1TF sidechannel mitigation for PV guests.

          Under a small number of specific workloads, shadow paging may be
          deliberately used as a performance optimisation.

          If unsure, say Y.

config BIGMEM
	bool "big memory support"
	default n
	help
	  Allows Xen to support up to 123Tb of memory.

	  This requires enlarging struct page_info as well as shrinking
	  the always accessible direct mapped memory range.

	  If unsure, say N.

config HVM_FEP
	bool "HVM Forced Emulation Prefix support (UNSUPPORTED)" if UNSUPPORTED
	default DEBUG
	depends on HVM
	help

	  Compiles in a feature that allows HVM guest to arbitrarily
	  exercise the instruction emulator.

	  This feature can only be enabled during boot time with
	  appropriate hypervisor command line option. Please read
	  hypervisor command line documentation before trying to use
	  this feature.

	  This is strictly for testing purposes, and not appropriate
	  for use in production.

	  If unsure, say N.

config TBOOT
	bool "Xen tboot support (UNSUPPORTED)"
	depends on INTEL && UNSUPPORTED
	default !PV_SHIM_EXCLUSIVE
	select CRYPTO
	help
	  Allows support for Trusted Boot using the Intel(R) Trusted Execution
	  Technology (TXT)

	  If unsure, stay with the default.

config X86_PSR
	bool "Platform Shared Resource support" if EXPERT
	default INTEL
	help
	  Support of Platform Shared Resource technology, which is basis for
	  monitoring and control of resources like cache and memory bandwidth.
	  See xl-psr documentation for details.

	  If unsure, stay with the default.

choice
	prompt "Alignment of Xen image"
	default XEN_ALIGN_2M if PV_SHIM_EXCLUSIVE
	default XEN_ALIGN_DEFAULT
	help
	  Specify alignment for Xen image.

	  If unsure, choose "default".

config XEN_ALIGN_DEFAULT
	bool "Default alignment"
	help
	  Pick alignment according to build variants.

	  For EFI build the default alignment is 2M. For ELF build
	  the default alignment is 4K due to syslinux failing to handle
	  the increment of image size induced by 2M alignment.

config XEN_ALIGN_2M
	bool "2M alignment"

endchoice

choice
	prompt "x2APIC Driver default"
	default X2APIC_MIXED
	help
	  Select APIC addressing when x2APIC is enabled.

	  The default mode is mixed which should provide the best aspects
	  of both physical and cluster modes.

config X2APIC_PHYSICAL
	bool "Physical Destination mode"
	help
	  When using this mode APICs are addressed using the Physical
	  Destination mode, which allows using all dynamic vectors on each
	  CPU independently.

	  Physical Destination has the benefit of having more vectors available
	  for external interrupts, but it also makes the delivery of multi
	  destination inter processor interrupts (IPIs) slightly slower than
	  Logical Destination mode.

config X2APIC_MIXED
	bool "Mixed Destination mode"
	help
	  When using this mode APICs are addressed using the Cluster Logical
	  Destination mode for IPIs and Physical mode for external interrupts.

	  Should provide the best of both modes.

endchoice

config GUEST
	bool

config XEN_GUEST
	bool "Xen Guest"
	select GUEST
	help
	  Support for Xen detecting when it is running under Xen.

	  If unsure, say N.

config PVH_GUEST
	def_bool y
	prompt "PVH Guest"
	depends on XEN_GUEST
	help
	  Support booting using the PVH ABI.

	  If unsure, say Y.

config PV_SHIM
	def_bool y
	prompt "PV Shim"
	depends on PV && XEN_GUEST
	help
	  Build Xen with a mode which acts as a shim to allow PV guest to run
	  in an HVM/PVH container. This mode can only be enabled with command
	  line option.

	  If unsure, say Y.

config PV_SHIM_EXCLUSIVE
	bool "PV Shim Exclusive"
	depends on PV_SHIM
	help
	  Build Xen in a way which unconditionally assumes PV_SHIM mode.  This
	  option is only intended for use when building a dedicated PV Shim
	  firmware, and will not function correctly in other scenarios.

	  If unsure, say N.

if !PV_SHIM_EXCLUSIVE

config HYPERV_GUEST
	bool "Hyper-V Guest"
	select GUEST
	help
	  Support for Xen detecting when it is running under Hyper-V.

	  If unsure, say N.

endif

config MEM_PAGING
	bool "Xen memory paging support (UNSUPPORTED)" if UNSUPPORTED
	depends on HVM

config MEM_SHARING
	bool "Xen memory sharing support (UNSUPPORTED)" if UNSUPPORTED
	depends on HVM

config REQUIRE_NX
	bool "Require NX (No eXecute) support"
	help
	  No-eXecute (also called XD "eXecute Disable" and DEP "Data
	  Execution Prevention") is a security feature designed originally
	  to combat buffer overflow attacks by marking regions of memory
	  which the CPU must not interpret as instructions.

	  The NX feature exists in every 64bit CPU except for some very
	  early Pentium 4 Prescott machines.

	  Enabling this option will improve Xen's security by removing
	  cases where Xen could be tricked into thinking that the feature
	  was unavailable. However, if enabled, Xen will no longer boot on
	  any CPU which is lacking NX support.

config ALTP2M
	bool "Alternate P2M support" if EXPERT
	depends on INTEL_VMX
	default y
	help
	  Alternate-p2m allows a guest to manage multiple p2m guest physical
	  "memory views" (as opposed to a single p2m).
	  Useful for memory introspection.

	  If unsure, stay with defaults.

endmenu

source "common/Kconfig"

source "drivers/Kconfig"
```

## xen/arch/x86/Kconfig.cpu
```kconfig
menu "Supported CPU vendors"
	visible if EXPERT

config AMD
	bool "Support AMD CPUs"
	default y
	help
	  Detection, tunings and quirks for AMD platforms.

	  May be turned off in builds targetting other vendors.  Otherwise,
	  must be enabled for Xen to work suitably on AMD platforms.

config INTEL
	bool "Support Intel CPUs"
	default y
	help
	  Detection, tunings and quirks for Intel platforms.

	  May be turned off in builds targetting other vendors.  Otherwise,
	  must be enabled for Xen to work suitably on Intel platforms.

endmenu
```

## xen/arch/x86/configs/pvshim_defconfig
```kconfig
# Enable PV shim mode
CONFIG_PV=y
CONFIG_XEN_GUEST=y
CONFIG_PVH_GUEST=y
CONFIG_PV_SHIM=y
CONFIG_PV_SHIM_EXCLUSIVE=y
CONFIG_NR_CPUS=32
CONFIG_EXPERT=y
# Disable features not used by the PV shim
# CONFIG_XEN_SHSTK is not set
# CONFIG_XEN_IBT is not set
# CONFIG_GRANT_TABLE is not set
# CONFIG_HYPFS is not set
# CONFIG_BIGMEM is not set
# CONFIG_KEXEC is not set
# CONFIG_XSM is not set
# CONFIG_UNSUPPORTED is not set
# CONFIG_SCHED_CREDIT is not set
# CONFIG_SCHED_CREDIT2 is not set
# CONFIG_SCHED_RTDS is not set
# CONFIG_SCHED_ARINC653 is not set
# CONFIG_LIVEPATCH is not set
# CONFIG_SUPPRESS_DUPLICATE_SYMBOL_WARNINGS is not set
# CONFIG_TRACEBUFFER is not set
# CONFIG_AMD_IOMMU is not set
# CONFIG_INTEL_IOMMU is not set
# CONFIG_DEBUG is not set
# CONFIG_GDBSX is not set
```
